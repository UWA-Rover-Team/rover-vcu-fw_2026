## boards/vendor/chenry/rover-vcu-v0/Kconfig.defconfig
```kconfig
# Rover VCU v0 board configuration

# Copyright (c) 2023 Thomas Stranger
# SPDX-License-Identifier: Apache-2.0

if BOARD_ROVER_VCU_V0

configdefault NET_L2_ETHERNET
	default y

endif # BOARD_ROVER_VCU_V0
```

## boards/vendor/chenry/rover-vcu-v0/Kconfig.rover_vcu_v0
```kconfig
# Copyright (c) 2023 Thomas Stranger
# SPDX-License-Identifier: Apache-2.0

config BOARD_ROVER_VCU_V0
	select SOC_STM32H563XX
```

## boards/vendor/chenry/rover-vcu-v0/board.yml
```yaml
board:
  name: rover_vcu_v0
  full_name: Rover VCU v0
  vendor: chenry
  socs:
    - name: stm32h563xx
```

## tests/app/udp_transport/testcase.yaml
```yaml
common:
  tags: udp_transport
  integration_platforms:
    - native_sim
tests:
  app.udp_transport: {}
```
