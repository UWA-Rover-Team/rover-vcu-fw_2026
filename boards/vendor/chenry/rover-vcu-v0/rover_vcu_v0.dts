/*
 * Copyright (c) 2021 Linaro Limited
 * Copyright (c) 2023 Thomas Stranger
 *
 * SPDX-License-Identifier: Apache-2.0
 */

/dts-v1/;
#include "rover_vcu_v0-common.dtsi"

/ {
	model = "Rover VCU v0";
	compatible = "chenry,rover-vcu-v0";

	#address-cells = <1>;
	#size-cells = <1>;

	chosen {
		zephyr,console = &uart7;
		zephyr,shell-uart = &uart7;
		zephyr,sram = &sram1;
		zephyr,flash = &flash0;
		zephyr,code-partition = &slot0_partition;
		zephyr,canbus = &fdcan2;
	};

	aliases {
		led0 = &led0;
		led1 = &led1;
		led2 = &led2;
		sw0 = &estop_btn;
		watchdog0 = &iwdg;
		volt-sensor0 = &vref;
		volt-sensor1 = &vbat;
        can-tele = &fdcan1;
        can-pt = &fdcan2;
	};
};

&rng {
	status = "okay";
};


