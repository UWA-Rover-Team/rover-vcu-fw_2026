## CMakeLists.txt
```
#-------------------------------------------------------------------------------
# Zephyr Example Application
#
# Copyright (c) 2021 Nordic Semiconductor ASA
# SPDX-License-Identifier: Apache-2.0

cmake_minimum_required(VERSION 3.13.1)
find_package(Zephyr REQUIRED HINTS $ENV{ZEPHYR_BASE})

project(app LANGUAGES C)

target_sources(app PRIVATE 
    src/main.c
    src/dhcp_req.c
    src/udp_transport.c
)

# The code below locates the git index file for this repository and adds it as a dependency for
# the application VERSION file so that if the repo has a new commit added, even if no files in
# the build have changed, the application version file will be regenerated with the new git commit
find_package(Git QUIET)
if(GIT_FOUND)
  execute_process(
    COMMAND ${GIT_EXECUTABLE} rev-parse --absolute-git-dir
    WORKING_DIRECTORY .
    OUTPUT_VARIABLE application_git_dir
    OUTPUT_STRIP_TRAILING_WHITESPACE
    ERROR_STRIP_TRAILING_WHITESPACE
    ERROR_VARIABLE stderr
    RESULT_VARIABLE return_code
  )
  # If there is an error e.g. it is not a git repo, we just silently ignore it and continue
  # without a dependency, this will be the case with freestanding applications.
  if(NOT return_code)
    if(NOT "${stderr}" STREQUAL "")
      message(WARNING "Application build version git rev-parse warned: ${stderr}")
    endif()

    set_property(TARGET app_version_h PROPERTY APP_VERSION_DEPENDS ${application_git_dir}/index)
  endif()
endif()
```

## Kconfig
```
# Copyright (c) 2021 Nordic Semiconductor ASA
# SPDX-License-Identifier: Apache-2.0
#
# This file is the application Kconfig entry point. All application Kconfig
# options can be defined here or included via other application Kconfig files.
# You can browse these options using the west targets menuconfig (terminal) or
# guiconfig (GUI).

menu "Zephyr"
source "Kconfig.zephyr"
endmenu

config VCU_PORTS_MOCK
    bool "Use mock port implementations for testing and debug"
    default n
    help
        replace real driver-backed port read/write with static mock data. 
        enable in debug.conf

config STATIC_VCU_DEV
    bool "Make network static for testing and debug"
    default n
    help
        replace dynamic configuration with static values. 
        enable in debug.conf

config GATEWAY_UDP_PORT
    int "can-util rx and tx port"
    default 5555
    help
        sets the port the linux driver uses

module = APP
module-str = APP
source "subsys/logging/Kconfig.template.log_config"
```

## prj.conf
```kconfig
CONFIG_NETWORKING=y
CONFIG_NET_SOCKETS=y
CONFIG_NET_IPV4=y
CONFIG_NET_UDP=y
CONFIG_LOG=y
CONFIG_CAN=y

CONFIG_NET_DHCPV4=y

# --- MCUmgr / DFU ---
CONFIG_MCUMGR=y
CONFIG_MCUMGR_GRP_IMG=y
CONFIG_MCUMGR_GRP_OS=y

# UDP transport
CONFIG_MCUMGR_TRANSPORT_UDP=y
CONFIG_MCUMGR_TRANSPORT_UDP_IPV4=y
CONFIG_MCUMGR_TRANSPORT_UDP_PORT=1337

# flash/image handling support
CONFIG_IMG_MANAGER=y
CONFIG_FLASH=y
CONFIG_FLASH_MAP=y
CONFIG_STREAM_FLASH=y

# needed by mcumgr's base64/CBOR encoding
CONFIG_BASE64=y
CONFIG_ZCBOR=y

CONFIG_GATEWAY_UDP_PORT=5555
```

## debug.conf
```kconfig
# Copyright (c) 2021 Nordic Semiconductor ASA
# SPDX-License-Identifier: Apache-2.0
#
# This is a Kconfig fragment which can be used to enable debug-related options
# in the application. See the README for more details.

# compiler
CONFIG_DEBUG_OPTIMIZATIONS=y

# logging
CONFIG_LOG=y
CONFIG_APP_LOG_LEVEL_DBG=y

CONFIG_MCUMGR_TRANSPORT_LOG_LEVEL_DBG=y
CONFIG_MCUMGR_GRP_IMG_LOG_LEVEL_DBG=y

CONFIG_VCU_PORTS_MOCK=y

CONFIG_SHELL=y

# telnet config
CONFIG_NET_TCP=y
CONFIG_SHELL_BACKEND_TELNET=y

CONFIG_STATIC_VCU_DEV=n
```

## src/main.c
```c
#include "dhcp_req.h"
#include "udp_transport.h"
#include <zephyr/app_version.h>
#include <zephyr/drivers/gpio.h>
#include <zephyr/kernel.h>

#include <zephyr/logging/log.h>
LOG_MODULE_REGISTER(main);

static void log_timer_handler(struct k_timer *timer) {
  LOG_DBG("Hello, World from Zephyr!");
}

K_TIMER_DEFINE(log_timer, log_timer_handler, NULL);

static const struct gpio_dt_spec led0 = GPIO_DT_SPEC_GET(DT_ALIAS(led0), gpios);
static const struct gpio_dt_spec led1 = GPIO_DT_SPEC_GET(DT_ALIAS(led1), gpios);
static const struct gpio_dt_spec led2 = GPIO_DT_SPEC_GET(DT_ALIAS(led2), gpios);

static void led_timer_handler(struct k_timer *timer) {
  gpio_pin_toggle_dt(&led0);
  gpio_pin_toggle_dt(&led1);
  gpio_pin_toggle_dt(&led2);
}

K_TIMER_DEFINE(led_timer, led_timer_handler, NULL);

struct UDPTransport udp_transport;

static void on_network_ready(struct net_if *iface) {
  udp_transport_init(&udp_transport);
}

int main(void) {

  LOG_WRN("Starting UDP to CAN Bus Gateway");
  LOG_WRN("APP VERSION V%s", APP_VERSION_EXTENDED_STRING);

  gpio_pin_configure_dt(&led0, GPIO_OUTPUT_INACTIVE);
  gpio_pin_configure_dt(&led1, GPIO_OUTPUT_ACTIVE);
  gpio_pin_configure_dt(&led2, GPIO_OUTPUT_INACTIVE);
  k_timer_start(&led_timer, K_NO_WAIT, K_MSEC(200));

  dhcp_req_start(on_network_ready);

  k_timer_start(&log_timer, K_MSEC(1000), K_MSEC(1000));
  return 0;
}
```

## src/app_types.h
```c
#pragma once
#include <zephyr/kernel.h>

// FSM States and Transitions
enum FSMStates {
  FSM_BOOTING,
  FSM_STOPPED,
  FSM_IDLE,
  FSM_EXECUTE,
  FSM_HOLDING,
  FSM_HELD,
  FSM_STOPPING,
  FSM_SUSPENDING,
  FSM_SUSPENDED,
  FSM_ABORTING,
  FSM_ABORTED,
  FSM_CLEARING
};

enum FSMTransitions {
  TRAN_EVT_NONE,
  TRAN_EVT_ENABLE,
  TRAN_EVT_BOOTED,
  TRAN_EVT_RUN,
  TRAN_EVT_HOLD,
  TRAN_EVT_RESUME,
  TRAN_EVT_STOP,
  TRAN_EVT_SUSPEND,
  TRAN_EVT_UNSUSPEND,
  TRAN_EVT_ESTOP,
  TRAN_EVT_FAULT_CLEAR,
  TRAN_EVT_ABORT,
};

// Input Ports
struct CommandHeader {
  uint8_t cmdType;
  uint32_t seqNum;
  int64_t timestampMs;
};

struct DriveVelocityCommand {
  struct CommandHeader hdr;
  float velocity;
  float headingRad;
};

struct DrivePositionCommand {
  struct CommandHeader hdr;
  float distance;
  float headingRad;
};

struct ArmCommand {
  struct CommandHeader hdr;
  uint16_t jointIdx;
  float armAngleRad;
};

struct SWSafetyCommands {
  enum FSMTransitions swCommand;
};

// Output Ports
struct IMUTelemetry {
  float ax, ay, az;
  float gx, gy, gz;
};

struct PowerTelemetry {
  float currentDraw;
  float batteryVoltage;
};

struct MotorStates {
  float wheelSpeedRPM;
  float wheelTorque;
  float encoderPositionRad;
  uint8_t isRunning;
};

struct ArmMotorStates {
  float encoderPositionRad;
  uint8_t isRunning;
};

struct PeripheralTelemetry {
  struct IMUTelemetry imu;
  struct PowerTelemetry power;
  struct MotorStates m1, m2, m3, m4;
  struct ArmMotorStates j1, j2, j3, j4, j5, j6;
};

// Safety State
struct SafetyState {
  bool estopAsserted;
  bool hwEnableActive;
  bool watchdogOk;
  bool upstreamHeartbeatOk;
  bool powerFault;
  bool motorFault;
  bool armFault;
  bool sensorFault;
};

// Internal Control Structs
struct VCUState {
  enum FSMStates cs, ns;
  struct SafetyState safety;

  // capabilities
  bool drive_allowed, arm_allowed, telemetry_active, config_mutable,
      manual_control_allowed, autonomy_control_allowed, fault_reset_allowed;
};

// Command Processing Telemetry
enum CommandStatus {
  CMD_ACCEPTED,
  CMD_REJECTED_FORMAT,
  CMD_REJECTED_STALE,
  CMD_REJECTED_SEQUENCE,
  CMD_REJECTED_WRONG_STATE,
  CMD_REJECTED_CAPABILITY,
  CMD_REJECTED_OUT_OF_RANGE,
  CMD_REJECTED_SAFETY,
  CMD_REJECTED_SUBSYSTEM
};

struct CommandTelemetry {
  enum CommandStatus lastStatus;
  uint32_t lastSeqNum;
  uint32_t acceptedCount;
  uint32_t rejectedCount;
};

// Diagnostic Counters
struct DiagnosticCounters {
  uint32_t uptimeMs;
  uint32_t resetCount;
  uint32_t rxPacketCount;
  uint32_t txPacketCount;
  uint32_t busErrorCount;
  uint32_t faultCount;
};

// Upstream Telemetry Output
struct VCUTelemetry {
  struct VCUState state;
  struct SafetyState safety;
  struct CommandTelemetry cmd;
  struct PeripheralTelemetry peripheral;
  struct DiagnosticCounters diag;
};
```

## src/canudp_proto.h
```c
#ifndef CANUDP_PROTO_H
#define CANUDP_PROTO_H

#include <stdint.h>
#include <string.h>

/*
 * Fixed 25-byte frame, one per UDP datagram. Matches the board's layout:
 *
 *   BYTE 0:     Protocol version
 *   BYTE 1:     Flags (EFF/RTR/ERR - see CANUDP_FLAG_*)
 *   BYTE 2-7:   Reserved (future timestamp)
 *   BYTE 8-12:  CAN ID, big-endian. Byte 8 is currently unused/reserved
 *               (29-bit extended ID only needs 4 bytes); free for later use
 *               (bus index, priority, etc).
 *   BYTE 13:    Data length, 0-8
 *   BYTE 14:    FD flags: 0 = classic CAN frame, non-zero = CAN FD
 *               (see CANUDP_FDFLAG_*)
 *   BYTE 15-16: Reserved (future timestamp)
 *   BYTE 17-24: Data, 8 bytes. NOTE: this is a cut-down FD profile -
 *               only the first 8 data bytes are carried even for FD
 *               frames (no support yet for the 12/16/20/24/32/48/64
 *               byte FD payload lengths).
 *
 * There's no magic number in this version - validity is checked via
 * (a) exact datagram length and (b) version byte. If you want stronger
 * protection against garbage/misrouted packets, one of the reserved
 * bytes could carry a magic value later.
 *
 * NOTE: this file must stay byte-for-byte identical between the board
 * firmware and canudp_daemon on the host - keep them in sync (e.g. a
 * shared submodule) rather than hand-copying edits to one side.
 */

#define CANUDP_VERSION 1

/* BYTE 1 - top-level frame flags */
#define CANUDP_FLAG_EFF 0x01u /* extended (29-bit) ID */
#define CANUDP_FLAG_RTR 0x02u /* remote transmission request */
#define CANUDP_FLAG_ERR 0x04u /* error frame (reserved, not handled yet) */

/* BYTE 14 - CAN FD flags. Zero means "classic CAN frame". */
#define CANUDP_FDFLAG_FDF 0x01u /* this is an FD frame, not classic       */
#define CANUDP_FDFLAG_BRS 0x02u /* bit rate switch                        */
#define CANUDP_FDFLAG_ESI 0x04u /* error state indicator                  */

#define CANUDP_ID_BYTES 5
#define CANUDP_DATA_LEN 8

struct __attribute__((packed)) canudp_frame {
  uint8_t version;                 /* offset 0      */
  uint8_t flags;                   /* offset 1      */
  uint8_t reserved0[6];            /* offset 2-7    */
  uint8_t can_id[CANUDP_ID_BYTES]; /* offset 8-12   */
  uint8_t len;                     /* offset 13     */
  uint8_t fd_flags;                /* offset 14     */
  uint8_t reserved1[2];            /* offset 15-16  */
  uint8_t data[CANUDP_DATA_LEN];   /* offset 17-24  */
};

#define CANUDP_FRAME_SIZE (sizeof(struct canudp_frame)) /* 25 bytes */

/* Pack/unpack the 5-byte big-endian CAN ID field. Byte 0 of the field
 * (overall offset 8) is left as reserved/zero for now. */
static inline void canudp_pack_id(uint8_t out[CANUDP_ID_BYTES], uint32_t id) {
  out[0] = 0;
  out[1] = (uint8_t)(id >> 24);
  out[2] = (uint8_t)(id >> 16);
  out[3] = (uint8_t)(id >> 8);
  out[4] = (uint8_t)(id);
}

static inline uint32_t canudp_unpack_id(const uint8_t in[CANUDP_ID_BYTES]) {
  return ((uint32_t)in[1] << 24) | ((uint32_t)in[2] << 16) |
         ((uint32_t)in[3] << 8) | (uint32_t)in[4];
}

#endif /* CANUDP_PROTO_H */
```

## src/dhcp_req.c
```c
#include "dhcp_req.h"

#include <zephyr/kernel.h>
#include <zephyr/net/net_if.h>
#include <zephyr/net/net_mgmt.h>
#include <zephyr/net/socket.h>

#include <zephyr/logging/log.h>
LOG_MODULE_REGISTER(dhcp_req);

#define DHCP_TIMEOUT_MS 10000
#define STATIC_IP_ADDR "192.168.8.158"
#define STATIC_IP_NETMASK "255.255.255.0"

static struct net_mgmt_event_callback dhcp_cb;
static atomic_t dhcp_bound = ATOMIC_INIT(0);
static struct k_work_delayable dhcp_timeout_work;
static dhcp_req_ready_cb_t ready_cb;

static void dhcp_fallback_handler(struct k_work *work) {
  if (atomic_get(&dhcp_bound)) {
    return;
  }

  LOG_WRN("DHCP timeout, falling back to static IP: %s", STATIC_IP_ADDR);

  struct net_if *iface = net_if_get_default();
#if !defined(CONFIG_STATIC_VCU_DEV)
  net_dhcpv4_stop(iface);
#endif

  struct in_addr addr, netmask;
  net_addr_pton(AF_INET, STATIC_IP_ADDR, &addr);
  net_addr_pton(AF_INET, STATIC_IP_NETMASK, &netmask);

  net_if_ipv4_addr_add(iface, &addr, NET_ADDR_MANUAL, 0);
  net_if_ipv4_set_netmask_by_addr(iface, &addr, &netmask);

  if (ready_cb) {
    ready_cb(iface);
  }
}

static void dhcp_handler(struct net_mgmt_event_callback *cb,
                         uint64_t mgmt_event, struct net_if *iface) {
  if (mgmt_event == NET_EVENT_IPV4_DHCP_BOUND) {
    atomic_set(&dhcp_bound, 1);
    k_work_cancel_delayable(&dhcp_timeout_work);

    char buf[NET_IPV4_ADDR_LEN];
    net_addr_ntop(AF_INET, &iface->config.dhcpv4.requested_ip, buf,
                  sizeof(buf));

    LOG_WRN("Received IP Lease: %s", buf);

    if (ready_cb) {
      ready_cb(iface);
    }
  }
}

void dhcp_req_start(dhcp_req_ready_cb_t on_ready) {
  ready_cb = on_ready;
  net_mgmt_init_event_callback(&dhcp_cb, dhcp_handler,
                               NET_EVENT_IPV4_DHCP_BOUND);
  net_mgmt_add_event_callback(&dhcp_cb);
#if defined(CONFIG_STATIC_VCU_DEV)
  LOG_INF("Static IP configuration enabled, skipping DHCP");
  k_work_init_delayable(&dhcp_timeout_work, dhcp_fallback_handler);
  k_work_schedule(&dhcp_timeout_work, K_MSEC(0));
#else

  struct net_if *iface = net_if_get_default();
  net_dhcpv4_start(iface);

  k_work_init_delayable(&dhcp_timeout_work, dhcp_fallback_handler);
  k_work_schedule(&dhcp_timeout_work, K_MSEC(DHCP_TIMEOUT_MS));
#endif
}
```

## src/dhcp_req.h
```c
#ifndef DHCP_REQ_H_
#define DHCP_REQ_H_

#include <zephyr/net/net_if.h>

typedef void (*dhcp_req_ready_cb_t)(struct net_if *iface);

void dhcp_req_start(dhcp_req_ready_cb_t on_ready);

#endif /* DHCP_REQ_H_ */
```

## src/udp_transport.c
```c
#include "udp_transport.h"
#include "syscalls/device.h"
#include <zephyr/logging/log.h>
LOG_MODULE_REGISTER(udp_transport);

const struct device *can_dev_0 = DEVICE_DT_GET(DT_NODELABEL(fdcan1));

K_THREAD_STACK_DEFINE(udp_rx_stack, UDP_THREAD_STACK_SIZE);
static struct k_thread udp_rx_thread_data;

K_THREAD_STACK_DEFINE(can_sniff_stack, CAN_SNIFF_STACK_SIZE);
static struct k_thread can_sniff_thread_data;

int udp_transport_init(struct UDPTransport *udp_transport) {

  LOG_INF("Initializing UDP Transport Layer");

  struct sockaddr_in bind_addr;
  int ret;

  udp_transport->udp_sock = zsock_socket(AF_INET, SOCK_DGRAM, IPPROTO_UDP);
  if (udp_transport->udp_sock < 0) {
    LOG_ERR("Failed to create UDP Socket: %d", errno);
    return -1;
  }

  memset(&bind_addr, 0, sizeof(bind_addr));
  bind_addr.sin_family = AF_INET;
  bind_addr.sin_port = htons(CONFIG_GATEWAY_UDP_PORT);
  bind_addr.sin_addr.s_addr = htonl(INADDR_ANY);

  ret = zsock_bind(udp_transport->udp_sock, (struct sockaddr *)&bind_addr,
                   sizeof(bind_addr));
  if (ret < 0) {
    LOG_ERR("Failed to bind UDP Socket %d", errno);
    zsock_close(udp_transport->udp_sock);
    udp_transport->udp_sock = -1;
    return -errno;
  }

  LOG_INF("Socket seems to be ready...");

  int broadcast_enable = 1;
  ret = zsock_setsockopt(udp_transport->udp_sock, SOL_SOCKET, SO_BROADCAST,
                         &broadcast_enable, sizeof(broadcast_enable));
  if (ret < 0) {
    LOG_WRN("SO_BROADCAST not available on this socket (%d) - continuing, "
            "broadcast sendto() should still work",
            errno);
  }

  // CAN BUS STARTUPS
  if (!device_is_ready(can_dev_0)) {
    LOG_ERR("Failed to start Telemetry CAN Bus");
    return 1;
  }

  can_set_mode(can_dev_0, CAN_MODE_NORMAL);

  struct can_timing timing;

  ret = can_calc_timing(can_dev_0, &timing, 250000, 875);
  if (ret > 0) {
    LOG_INF("Sample-Point error: %d", ret);
  }

  ret = can_set_timing(can_dev_0, &timing);
  if (ret != 0) {
    LOG_ERR("Failed to set timing");
  }

  ret = can_start(can_dev_0);
  if (ret < 0) {
    LOG_ERR("Failed to start Telemetry CAN Bus");
    return -1;
  }

  // start the udp threads
  k_msgq_init(&udp_transport->rx_msgq, (char *)udp_transport->rx_msgq_buffer,
              sizeof(struct UDPReceivedPacket), 100);

  k_msgq_init(&udp_transport->tx_msgq, (char *)udp_transport->tx_msgq_buffer,
              sizeof(struct UDPTransmittedPacket), 100);

  k_thread_create(&udp_rx_thread_data, udp_rx_stack,
                  K_THREAD_STACK_SIZEOF(udp_rx_stack), udp_rx_thread,
                  udp_transport, NULL, NULL, UDP_TRANSPORT_THREAD_PRIORITY, 0,
                  K_NO_WAIT);

  k_msgq_init(&udp_transport->can_rx_msgq,
              (char *)udp_transport->can_rx_msgq_buffer,
              sizeof(struct can_frame), CAN_SNIFF_MSGQ_DEPTH);

  const struct can_filter std_filter = {
      .id = 0,
      .mask = 0,
      .flags = 0,
  };

  const struct can_filter ext_filter = {
      .id = 0,
      .mask = 0,
      .flags = CAN_FILTER_IDE,
  };

  ret = can_add_rx_filter_msgq(can_dev_0, &udp_transport->can_rx_msgq,
                               &std_filter);
  if (ret < 0) {
    LOG_ERR("Failed to add CAN std-id sniff filter: %d", ret);
  }

  ret = can_add_rx_filter_msgq(can_dev_0, &udp_transport->can_rx_msgq,
                               &ext_filter);
  if (ret < 0) {
    LOG_ERR("Failed to add CAN ext-id sniff filter: %d", ret);
  }

  k_thread_create(&can_sniff_thread_data, can_sniff_stack,
                  K_THREAD_STACK_SIZEOF(can_sniff_stack), can_sniff_thread,
                  udp_transport, NULL, NULL, CAN_SNIFF_THREAD_PRIORITY, 0,
                  K_NO_WAIT);

  LOG_INF("Socket ready...");

  return 0;
}

int udp_parse_frame(uint8_t *rx_buf, int len, struct can_frame *can_frame) {

  if (len != (int)CANUDP_FRAME_SIZE) {
    LOG_ERR("Unexpected packet size %d (expected %d)", len,
            (int)CANUDP_FRAME_SIZE);
    return -1;
  }

  struct canudp_frame w;
  memcpy(&w, rx_buf, sizeof(w));

  if (w.version != CANUDP_VERSION) {
    LOG_ERR("Unexpected protocol version %x", w.version);
    return -1;
  }

  uint32_t can_id = canudp_unpack_id(w.can_id);
  uint8_t can_flags = 0;

  if (w.flags & CANUDP_FLAG_EFF) {
    can_id &= CAN_EXT_ID_MASK;
    can_flags |= CAN_FRAME_IDE;
  } else {
    can_id &= CAN_STD_ID_MASK;
  }
  if (w.flags & CANUDP_FLAG_RTR) {
    can_flags |= CAN_FRAME_RTR;
  }

  uint8_t dlc = w.len;
  if (dlc > CANUDP_DATA_LEN) {
    dlc = CANUDP_DATA_LEN;
    LOG_WRN("Cannot exceed 8 DLC - only sending 8 bytes and setting DLC to 8");
  }

  // TODO: extend to FD oneday; for now, we just care about classic, so
  // w.fd_flags is ignored here.
  memset(can_frame, 0, sizeof(*can_frame));
  can_frame->id = can_id;
  can_frame->dlc = dlc;
  can_frame->flags = can_flags;
  memcpy(can_frame->data, w.data, dlc);

  LOG_INF("Protocol Version %x", w.version);
  LOG_INF("Target CANID %x", can_id);
  LOG_INF("Target DLC %x", dlc);
  LOG_HEXDUMP_INF(can_frame->data, 8, "CAN Data");

  return 0;
}

void udp_rx_thread(void *p1, void *p2, void *p3) {
  int ret = 0;
  ARG_UNUSED(p2);
  ARG_UNUSED(p3);

  // p1 is a udp_transport type; we get sock from there
  struct UDPTransport *udp_transport = (struct UDPTransport *)p1;

  LOG_WRN("UDP RX Thread started, listening on port %d",
          CONFIG_GATEWAY_UDP_PORT);

  for (;;) {
    uint8_t rx_buf[UDP_PACKET_SIZE] = {0};
    struct can_frame frame = {0};

    int pkt_size =
        zsock_recv(udp_transport->udp_sock, rx_buf, UDP_PACKET_SIZE, 0);
    if (pkt_size < 0) {
      LOG_ERR("Packet was a dud...");
      continue;
    }

    int parse_ret = udp_parse_frame(rx_buf, pkt_size, &frame);
    if (parse_ret < 0) {
      LOG_ERR("Failed to parse frame...");
      continue;
    }

    LOG_HEXDUMP_INF(rx_buf, pkt_size, "RX buffer");

    ret = can_send(can_dev_0, &frame, K_MSEC(100), NULL, NULL);

    if (ret < 0) {
      enum can_state state;
      struct can_bus_err_cnt err_cnt;

      if (can_get_state(can_dev_0, &state, &err_cnt) == 0) {
        LOG_ERR("can state: %d, tx_err_cnt: %d, rx_err_cnt: %d", state,
                err_cnt.tx_err_cnt, err_cnt.rx_err_cnt);
      }
    }
  }
}

void can_sniff_thread(void *p1, void *p2, void *p3) {
  ARG_UNUSED(p2);
  ARG_UNUSED(p3);

  struct UDPTransport *udp_transport = (struct UDPTransport *)p1;
  struct can_frame frame;

  struct sockaddr_in bcast_addr = {
      .sin_family = AF_INET,
      .sin_port = htons(CONFIG_GATEWAY_UDP_PORT),
      .sin_addr.s_addr = htonl(INADDR_BROADCAST),
  };

  LOG_WRN("CAN sniff thread started, broadcasting on port %d",
          CONFIG_GATEWAY_UDP_PORT);

  for (;;) {
    k_msgq_get(&udp_transport->can_rx_msgq, &frame, K_FOREVER);

    struct canudp_frame w;
    memset(&w, 0, sizeof(w));
    w.version = CANUDP_VERSION;

    uint32_t id = frame.id;
    if (frame.flags & CAN_FRAME_IDE) {
      w.flags |= CANUDP_FLAG_EFF;
      id &= CAN_EXT_ID_MASK;
    } else {
      id &= CAN_STD_ID_MASK;
    }
    if (frame.flags & CAN_FRAME_RTR) {
      w.flags |= CANUDP_FLAG_RTR;
    }
    canudp_pack_id(w.can_id, id);

    // NOTE: classic CAN only for now - frame.dlc is already a byte
    // count (0-8) here. If FD support is added later this needs
    // can_dlc_to_bytes(frame.dlc), and w.fd_flags would need setting.
    uint8_t data_len = frame.dlc;
    if (data_len > CANUDP_DATA_LEN) {
      data_len = CANUDP_DATA_LEN;
    }
    w.len = data_len;
    w.fd_flags = 0;
    memcpy(w.data, frame.data, data_len);

    // this is a bare struct canudp_frame on the wire - same 25-byte
    // format canudp_daemon already speaks, no extra header
    int ret = zsock_sendto(udp_transport->udp_sock, &w, sizeof(w), 0,
                           (struct sockaddr *)&bcast_addr, sizeof(bcast_addr));
    if (ret < 0) {
      LOG_WRN("Failed to broadcast sniffed CAN frame: %d", errno);
    }
  }
}
```

## src/udp_transport.h
```c
/*
 * UDP transport layer, bound to CONFIG_GATEWAY_UDP_PORT (5555 by default).
 * Carries two independent, unrelated wire formats over the same socket:
 *
 *  1. CAN-over-UDP passthrough (struct canudp_frame, see canudp_proto.h).
 *     Fixed 25-byte datagrams with no framing/type byte of their own -
 *     any datagram of exactly CANUDP_FRAME_SIZE is treated as one of
 *     these. This is what the host-side canudp_daemon "driver shim"
 *     (tools/canudp/canudp_daemon.c) speaks: it exposes a virtual
 *     SocketCAN interface (vcan) to can-utils tools (cansend, candump,
 *     etc.) and bridges raw CAN traffic to/from the board over UDP.
 *       - device -> host: can_sniff_thread() forwards every received CAN
 *         frame as a canudp_frame broadcast to CONFIG_GATEWAY_UDP_PORT.
 *       - host -> device: udp_rx_thread() parses inbound datagrams with
 *         udp_parse_frame() and injects the decoded frame onto the CAN
 *         bus via can_send().
 *
 *  2. Application command/telemetry protocol (struct UDPPacketHeader +
 *     enum PacketType below). A small type/version/len header followed
 *     by one of the payload structs in app_types.h (drive/arm/safety
 *     commands inbound, telemetry outbound via struct UDPReceivedPacket
 *     / struct UDPTransmittedPacket). Parsed by udp_transport_rx_parse().
 *
 * The two formats are disambiguated purely by datagram length (exactly
 * CANUDP_FRAME_SIZE selects protocol 1); there is no protocol-id byte.
 */

#pragma once
#include "app_types.h"
#include "canudp_proto.h"
#include <zephyr/drivers/can.h>
#include <zephyr/kernel.h>
#include <zephyr/net/socket.h>

#define UDP_PACKET_SIZE 1024
#define UDP_THREAD_STACK_SIZE 2048
#define UDP_TRANSPORT_THREAD_PRIORITY 5

#define CAN_SNIFF_MSGQ_DEPTH 64
#define CAN_SNIFF_STACK_SIZE 2048
#define CAN_SNIFF_THREAD_PRIORITY 5

/* Header for protocol 2 (app command/telemetry). `len` is the payload
 * size in bytes that follows this header and must match sizeof() of
 * the struct selected by `type` (see enum PacketType). */
struct UDPPacketHeader {
  uint8_t type;
  uint8_t version;
  uint16_t len;
};

enum PacketType {
  // transmit
  PKT_RX_DRIVE_VEL_CMD = 1,
  PKT_RX_DRIVE_POS_CMD = 2,
  PKT_RX_ARM_CMD = 3,
  PKT_RX_SW_SAFETY_CMD = 4,

  // receive
  PKT_TX_IMU_TELEMETRY = 11,
  PKT_TX_POWER_TELEMETRY = 12,
  PKT_TX_MOTOR_STATES = 13,
  PKT_TX_ARM_MOTOR_STATES = 14,
  PKT_TX_PERIPHERAL_TELEMETRY = 15,
  PKT_TX_SAFETY_STATE = 16,
};

struct UDPTransport {
  int udp_sock;
  // msgq for received packets to main control loop
  struct k_msgq rx_msgq;
  struct k_msgq tx_msgq;
  struct UDPReceivedPacket *rx_msgq_buffer[100];
  struct UDPTransmittedPacket *tx_msgq_buffer[100];

  struct k_msgq can_rx_msgq;
  struct can_frame can_rx_msgq_buffer[CAN_SNIFF_MSGQ_DEPTH];
};

struct UDPReceivedPacket {
  enum PacketType type;
  union {
    struct DriveVelocityCommand drive_vel_cmd;
    struct DrivePositionCommand drive_pos_cmd;
    struct ArmCommand arm_cmd;
    struct SWSafetyCommands sw_safety_cmd;
  };
};

struct UDPTransmittedPacket {
  enum PacketType type;
  union {
    struct IMUTelemetry imu_telemetry;
    struct PowerTelemetry power_telemetry;
    struct MotorStates motor_states;
    struct ArmMotorStates arm_motor_states;
    struct PeripheralTelemetry peripheral_telemetry;
    struct SafetyState safety_state;
  };
};

int udp_transport_init(struct UDPTransport *udp_transport);
struct UDPReceivedPacket
udp_transport_rx_parse(struct UDPTransport *udp_transport, uint8_t *buf,
                       ssize_t len);
void udp_rx_thread(void *p1, void *p2, void *p3);
struct UDPReceivedPacket
udp_transport_rx_parse(struct UDPTransport *udp_transport, uint8_t *buf,
                       ssize_t len);
void can_sniff_thread(void *p1, void *p2, void *p3);
```
